ENTRY(_start)

SECTIONS
{
    . = 1M;

    .limine_requests ALIGN(8) :
    {
        KEEP(*(.limine_requests))
    }

    .text ALIGN(4K) :
    {
        *(.text*)
    }

    .rodata ALIGN(4K) :
    {
        *(.rodata*)
    }

    .data ALIGN(4K) :
    {
        *(.data*)
    }

    .bss ALIGN(4K) :
    {
        *(COMMON)
        *(.bss*)
    }
}
